#include "app_oled_font.h"

#include <stdbool.h>
#include <string.h>

#define FONT_FIRST  0x20
#define FONT_LAST   0x7E
#define FONT_W      5
#define FONT_H      7
#define FONT_GAP    1

/* Adafruit GFX 5x7 (ASCII 0x20-0x7E). Each byte is a column; bit 0 is top pixel. */
static const uint8_t s_font5x7[] = {
    0x00, 0x00, 0x00, 0x00, 0x00, 0x3e, 0x5b, 0x4f, 0x5b, 0x3e, 0x3e, 0x6b, 0x4f, 0x6b, 0x3e, 0x1c,
    0x3e, 0x7c, 0x3e, 0x1c, 0x18, 0x3c, 0x7e, 0x3c, 0x18, 0x1c, 0x57, 0x7d, 0x57, 0x1c, 0x1c, 0x5e,
    0x7f, 0x5e, 0x1c, 0x00, 0x18, 0x3c, 0x18, 0x00, 0xff, 0xe7, 0xc3, 0xe7, 0xff, 0x00, 0x18, 0x24,
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    0x20, 0x00, 0x41, 0x41, 0x41, 0x7f, 0x04, 0x02, 0x01, 0x02, 0x04,
};

static void fb_set_pixel(uint8_t *fb, int width, int height, int x, int y, bool on)
{
    if (x < 0 || y < 0 || x >= width || y >= height) {
        return;
    }
    const int page = y / 8;
    const int bit = y % 8;
    const int idx = page * width + x;
    if (on) {
        fb[idx] |= (uint8_t)(1 << bit);
    } else {
        fb[idx] &= (uint8_t)~(1 << bit);
    }
}

void oled_font_clear(uint8_t *fb, int width, int height)
{
    memset(fb, 0, (size_t)(width * height / 8));
}

void oled_font_draw_str(uint8_t *fb, int x, int y, int width, int height, const char *str)
{
    if (str == NULL) {
        return;
    }

    while (*str != '\0' && x < width) {
        unsigned char c = (unsigned char)*str++;
        if (c < FONT_FIRST || c > FONT_LAST) {
            c = '?';
        }
        const uint8_t *glyph = &s_font5x7[(c - FONT_FIRST) * FONT_W];
        const int top = y - (FONT_H - 1);

        for (int col = 0; col < FONT_W && (x + col) < width; col++) {
            uint8_t col_data = glyph[col];
            for (int row = 0; row < FONT_H; row++) {
                if (col_data & (1 << row)) {
                    fb_set_pixel(fb, width, height, x + col, top + row, true);
                }
            }
        }
        x += FONT_W + FONT_GAP;
    }
}
